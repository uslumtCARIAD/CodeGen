AUTOSAR XML (schema 4-0-3)
standard types defined: Double, float64
