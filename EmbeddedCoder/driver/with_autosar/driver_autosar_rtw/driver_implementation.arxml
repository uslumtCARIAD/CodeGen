AUTOSAR XML (schema 4-0-3)
package /driver_pkg/driver_imp
  swc implementation driver: programming-language=C, sw-version=1.2.1, used-code-generator=Embedded Coder 6.13 (R2017b) 24-Jul-2017, vendor-id=0, behavior=driver
    code-descriptors:
      code Code
        artifact-descriptors:
          short-label=driver_c, category=SWSRC
          short-label=driver_data_c, category=SWSRC
          short-label=driver_h, category=SWHDR
          short-label=driver_private_h, category=SWHDR
          short-label=driver_types_h, category=SWHDR
          short-label=rtwtypes_h, category=SWHDR
    resource consumption RsrcCons_driver
