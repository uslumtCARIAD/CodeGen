AUTOSAR XML (schema 4-0-3)
package /driver_pkg/driver_if
  sender receiver interface Out1
    data Out1: category=VALUE, sw-calibration-access=READ-ONLY, type=Double
  sender receiver interface Out2
    data Out2: category=VALUE, sw-calibration-access=READ-ONLY, type=Double
