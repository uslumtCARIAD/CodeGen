AUTOSAR XML (schema 4-0-3)
package /add_pkg/add_imp
  swc implementation add: programming-language=C, sw-version=1.1.1, used-code-generator=Embedded Coder 6.13 (R2017b) 24-Jul-2017, vendor-id=0, behavior=add
    code-descriptors:
      code Code
        artifact-descriptors:
          short-label=add_c, category=SWSRC
          short-label=add_h, category=SWHDR
          short-label=add_private_h, category=SWHDR
          short-label=add_types_h, category=SWHDR
          short-label=rtwtypes_h, category=SWHDR
    resource consumption RsrcCons_add
