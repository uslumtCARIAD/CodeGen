AUTOSAR XML (schema 4-0-3)
package /add_pkg/add_if
  sender receiver interface input1
    data input1: category=VALUE, sw-calibration-access=READ-ONLY, type=Double
  sender receiver interface input2
    data input2: category=VALUE, sw-calibration-access=READ-ONLY, type=Double
  sender receiver interface output
    data output: category=VALUE, sw-calibration-access=READ-ONLY, type=Double
